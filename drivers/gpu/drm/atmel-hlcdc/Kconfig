## drivers/gpu/drm/atmel-hlcdc/Kconfig
```kconfig
# SPDX-License-Identifier: GPL-2.0-only
config DRM_ATMEL_HLCDC
	tristate "DRM Support for ATMEL HLCDC Display Controller"
	depends on DRM && OF && COMMON_CLK && MFD_ATMEL_HLCDC && ARM
	select DRM_GEM_CMA_HELPER
	select DRM_KMS_HELPER
	select DRM_KMS_CMA_HELPER
	select DRM_PANEL
	select DRM_DW_MIPI_DSI
	help
	  Choose this option if you have an ATMEL SoC with an HLCDC display
	  controller (i.e. at91sam9n12, at91sam9x5 family or sama5d3 family).

config ATMEL_XLCDC
	tristate "Support for Synopsys MIPI DSI Bridge"
	depends on DRM_ATMEL_HLCDC
	select DRM_DW_MIPI_DSI
	help
	  This option enables support for synopsys MIPI DSI bridge.
	  This will be removed in future.
```
